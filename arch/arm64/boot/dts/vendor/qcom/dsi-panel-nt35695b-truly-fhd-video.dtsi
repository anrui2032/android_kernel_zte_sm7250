&mdss_mdp {
	dsi_nt35695b_truly_fhd_video: qcom,mdss_dsi_nt35695b_truly_fhd_video {
		qcom,mdss-dsi-panel-name =
				"nt35695b truly fhd video mode dsi panel";
		qcom,mdss-dsi-panel-type = "dsi_video_mode";

		qcom,dsi-ctrl-num = <0>;
		qcom,dsi-phy-num = <0>;

		qcom,mdss-dsi-virtual-channel-id = <0>;
		qcom,mdss-dsi-stream = <0>;
		qcom,mdss-dsi-bpp = <24>;
		qcom,mdss-dsi-color-order = "rgb_swap_rgb";
		qcom,mdss-dsi-underflow-color = <0xff>;
		qcom,mdss-dsi-border-color = <0>;
		qcom,mdss-dsi-h-sync-pulse = <0>;
		qcom,mdss-dsi-traffic-mode = "non_burst_sync_event";
		qcom,mdss-dsi-lane-map = "lane_map_0123";
		qcom,mdss-dsi-bllp-eof-power-mode;
		qcom,mdss-dsi-bllp-power-mode;
		qcom,mdss-dsi-tx-eot-append;
		qcom,mdss-dsi-lane-0-state;
		qcom,mdss-dsi-lane-1-state;
		qcom,mdss-dsi-lane-2-state;
		qcom,mdss-dsi-lane-3-state;
		qcom,mdss-dsi-dma-trigger = "trigger_sw";
		qcom,mdss-dsi-mdp-trigger = "none";
		qcom,mdss-dsi-lp11-init;
		qcom,mdss-dsi-bl-pmic-control-type = "bl_ctrl_dcs";
		qcom,mdss-dsi-reset-sequence = <1 10>, <0 10>, <1 10>;

		qcom,mdss-dsi-display-timings {
			timing@0 {
				qcom,mdss-dsi-panel-width = <1080>;
				qcom,mdss-dsi-panel-height = <2340>;
				qcom,mdss-dsi-h-front-porch = <16>;
				qcom,mdss-dsi-h-back-porch = <16>;
				qcom,mdss-dsi-h-pulse-width = <4>;
				qcom,mdss-dsi-h-sync-skew = <0>;
				qcom,mdss-dsi-v-back-porch = <12>;
				qcom,mdss-dsi-v-front-porch = <112>;
				qcom,mdss-dsi-v-pulse-width = <4>;
				qcom,mdss-dsi-h-sync-pulse = <0>;
				qcom,mdss-dsi-h-left-border = <0>;
				qcom,mdss-dsi-h-right-border = <0>;
				qcom,mdss-dsi-v-top-border = <0>;
				qcom,mdss-dsi-v-bottom-border = <0>;
				qcom,mdss-dsi-panel-framerate = <60>;
				qcom,mdss-dsi-on-command = [39 01 00 00 00 00 04 b9 83 11 2a
					39 01 00 00 00 00 09 b1 08 1f 1f 80 80
					   4a 4a aa
					39 01 00 00 00 00 10 b2 00 02 00 90 24
					   00 0f 1e e9 11 11 00 10 a3 07
					39 01 00 00 00 00 1c b4 a8 34 a8 34 a8
					   34 05 b6 05 b6 05 b6 00 ff 00 ff 00
					   00 03 14 00 27 07 07 10 00 87
					39 01 00 00 00 00 02 bd 01
					39 01 00 00 00 00 02 b1 b6 
					39 01 00 00 00 00 10 b2 50 10 32 54 76
					   98 ba bc fe ff 80 00 ff 00 40
					39 01 00 00 00 00 02 bd 02
					39 01 00 00 00 00 0a b4 34 12 12 22 88
					   12 12 00 73
					39 01 00 00 00 00 02 bd 00
					39 01 00 00 00 00 04 b6 83 83 e3 
					39 01 00 00 00 00 0a bf 0f 00 00 83 9f
					   3e 00 05 00
					39 01 00 00 00 00 08 c0 23 23 00 45 00
					   00 09
					39 01 00 00 00 00 02 bd 03
					39 01 00 00 00 00 3a c1 ff f9 f5 f0 eb
					   e6 e1 d6 d1 cc c6 c1 bc b7 b1 ac a7
					   a1 9c 92 89 80 78 70 67 60 58 51 4a
					   44 3e 37 30 2a 24 1e 18 12 0d 07 05
					   03 02 01 00 31 53 df 89 2b f5 8c 52
					   90 b1 bd 00
					39 01 00 00 00 00 02 bd 02
					39 01 00 00 00 00 3a c1 ff f9 f5 f0 eb
					   e6 e1 d6 d1 cc c6 c1 bc b7 b1 ac a7
					   a1 9c 92 89 80 78 70 67 60 58 51 4a
					   44 3e 37 30 2a 24 1e 18 12 0d 07 05
					   03 02 01 00 31 53 df 89 2b f5 8c 52
					   90 b1 bd 00
					39 01 00 00 00 00 02 bd 01
					39 01 00 00 00 00 3a c1 ff f9 f5 f0 eb
					   e6 e1 d6 d1 cc c6 c1 bc b7 b1 ac a7
					   a1 9c 92 89 80 78 70 67 60 58 51 4a
					   44 3e 37 30 2a 24 1e 18 12 0d 07 05
					   03 02 01 00 31 53 df 89 2b f5 8c 52
					   90 b1 bd 00 
					39 01 00 00 00 00 02 bd 00
					39 01 00 00 00 00 02 c1 01
					39 01 00 00 00 00 07 c7 70 00 04 e0 33
					   00
					39 01 00 00 00 00 05 c9 04 08 cc 01
					39 01 00 00 00 00 02 cc 08
					39 01 00 00 00 00 05 cf 00 14 00 c0
					39 01 00 00 00 00 03 d2 23 23
					39 01 00 00 05 00 2c d3 50 00 00 00 00
					   01 00 04 04 05 05 33 38 10 10 10 10
					   32 10 0f 00 0f 32 10 0f 00 0f 32 10
					   08 00 00 00 00 00 00 00 00 00 0b 01
					   09 00
					39 01 00 00 05 00 31 d5 18 18 18 18 18
					   18 18 18 18 18 18 18 2f 2f 30 30 31
					   31 35 35 36 36 37 37 c0 c0 24 24 18
					   18 19 19 19 19 01 00 03 02 05 04 18
					   18 18 18 18 18 18 18
					39 01 00 00 05 00 31 d6 18 18 18 18 18
					   18 18 18 18 18 18 18 2f 2f 30 30 31
					   31 35 35 36 36 37 37 40 40 24 24 19
					   19 18 18 19 19 02 03 00 01 04 05 18
					   18 18 18 18 18 18 18
					39 01 00 00 00 00 19 d8 aa af ea bb ff
					   ae aa af ea bb ff ae aa af ea ab bf
					   aa aa af ea ab bf aa
					39 01 00 00 00 00 02 bd 01
					39 01 00 00 00 00 19 d8 aa a0 00 cb c0
					   aa aa a0 00 cb c0 aa aa a0 00 cb c0
					   aa aa a0 00 cb c0 aa
					39 01 00 00 00 00 02 bd 02
					39 01 00 00 00 00 0d d8 aa af ea fb ff
					   ae aa af ea fb ff ae
					39 01 00 00 00 00 02 bd 03
					39 01 00 00 00 00 19 d8 aa aa bf ab aa
					   aa aa aa bf ab aa aa aa af ea fb ff
					   ae aa af ea fb ff ae
					39 01 00 00 00 00 02 bd 00
					39 01 00 00 00 00 18 e7 0e 0e 1e 66 1c
					   66 00 50 02 02 00 00 02 02 02 05 14
					   14 32 b9 23 b9 08
					39 01 00 00 00 00 02 bd 01
					39 01 00 00 00 00 09 e7 02 00 a8 01 a8
					   0d a0 0e
					39 01 00 00 00 00 02 bd 02
					39 01 00 00 00 00 1e e7 00 00 08 00 01
					   00 00 00 00 00 00 00 00 00 00 00 00
					   00 00 00 00 00 04 00 00 00 00 02 00
					39 01 00 00 00 00 02 bd 00
					39 01 00 00 00 00 02 e9 c3
					39 01 00 00 00 00 03 cb d1 d4
					39 01 00 00 00 00 02 e9 3f
					39 01 00 00 00 00 02 bd 01
					39 01 00 00 00 00 02 e9 c6
					39 01 00 00 05 00 04 d3 4a 00 81
					39 01 00 00 00 00 02 e9 3f
					39 01 00 00 00 00 02 bd 00
					39 01 00 00 00 00 02 e9 e8
					39 01 00 00 05 00 04 d3 01 09 35
					39 01 00 00 00 00 02 e9 3f
					39 01 00 00 00 00 03 51 00 00
					39 01 00 00 00 00 02 53 24
					39 01 00 00 0a 00 02 55 00 05 01 00 00
					   78 00 02 11 00 05 01 00 00 14 00 02
					   29 00];
				qcom,mdss-dsi-off-command = [05 01 00 00
					32 00 02 28 00 05 01 00 00 78 00
					02 10 00];
				qcom,mdss-dsi-on-command-state = "dsi_lp_mode";
				qcom,mdss-dsi-off-command-state = "dsi_lp_mode";
			};
		};
	};
};
