/dts-v1/;

#include "lito.dtsi"

/ {
	model = "Qualcomm Technologies, Inc. Lito SoC";
	compatible = "qcom,lito";
	qcom,board-id = <0 0>;
};

&pm8008_regulators {
    /delete-property/ vdd_l6-supply;
};
