&qupv3_se7_i2c {
	status = "ok";
	synaptics_tcm@22 {
		compatible = "synaptics,tcm-i2c";
		reg = <0x22>;
		interrupt-parent = <&tlmm>;
		interrupts = <9 0x2008>;
		vdd-supply = <&pm8150_s4>;
		avdd-supply = <&pm8150_l13>;
		synaptics,bus-reg-name = "vdd";
		synaptics,pwr-reg-name = "avdd";
		synaptics,irq-gpio = <&tlmm 9 0x2008>;
		synaptics,irq-on-state = <0>;
		synaptics,reset-gpio = <&tlmm 8 0x0>;
		synaptics,reset-on-state = <0>;
		synaptics,reset-active-ms = <2>;
		synaptics,reset-delay-ms = <100>;
		synaptics,power-delay-ms = <200>;
		synaptics,ubl-i2c-addr = <0x22>;
		panel = <&dsi_visionox_rm692a4_otpt3_cmd &dsi_visionox_rm692a4_nootp_cmd
			 &dsi_visionox_rm692a4_amoled_fhd_cmd>;
	};
};
