/dts-v1/;
/plugin/;

#include <dt-bindings/interrupt-controller/arm-gic.h>
#include "litomagnus-mtp.dtsi"
#include "zte-litomagnus-vendor.dtsi"
#include "lito-v2-audio.dtsi"

/ {
	model = "Qualcomm Technologies, Inc. Litomagnus MTP";
	compatible = "qcom,lito-mtp", "qcom,lito", "qcom,mtp";
	qcom,msm-id = <400 0x20000>, <440 0x20000>;
	qcom,board-id = <5 1>;
};

/*
 * overriding adsp-fw-names with empty string
 * to allow default adsp img load
 */
&adsp_loader {
	adsp-fw-names="";
};
